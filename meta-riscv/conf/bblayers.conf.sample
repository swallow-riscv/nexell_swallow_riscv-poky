## meta-riscv/conf/bblayers.conf.sample
```bitbake
# LAYER_CONF_VERSION is increased each time build/conf/bblayers.conf
# changes incompatibly
LCONF_VERSION = "6"

BBPATH = "${TOPDIR}"
BBFILES ?= ""

BBLAYERS ?= " \
  ${TOPDIR}/../riscv-poky/meta \
  ${TOPDIR}/../riscv-poky/meta-yocto \
  ${TOPDIR}/../riscv-poky/meta-yocto-bsp \
  ${TOPDIR}/../riscv-poky/meta-riscv \
  ${TOPDIR}/../riscv-poky/meta-nexell \
  ${TOPDIR}/../meta-openembedded/meta-oe \
  ${TOPDIR}/../meta-openembedded/meta-networking \
  ${TOPDIR}/../meta-openembedded/meta-python \
  "
BBLAYERS_NON_REMOVABLE ?= " \
  ${TOPDIR}/../riscv-poky/meta \
  ${TOPDIR}/../riscv-poky/meta-yocto \
  "

BBMASK += "python-pyqt"
BBMASK += "ypbind-mt"
BBMASK += "yp-tools"
BBMASK += "${TOPDIR}/../meta-openembedded/meta-oe/recipes-support/maliit "
BBMASK += "${TOPDIR}/../meta-openembedded/meta-oe/recipes-qt "
BBMASK += "${TOPDIR}/../meta-openembedded/meta-oe/recipes-navigation "
BBMASK += "${TOPDIR}/../meta-openembedded/meta-oe/recipes-extended "
```
